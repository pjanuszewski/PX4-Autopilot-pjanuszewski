## src/examples/fly_mission/Kconfig
```kconfig
menuconfig EXAMPLES_FLY_MISSION
	bool "fly_mission"
	default n
	---help---
		Enable support for fly_mission
```

## src/examples/lqr_app/Kconfig
```kconfig
menuconfig EXAMPLES_LQR_APP
	bool "lqr_app"
	default n
	---help---
		Enable support for lqr_app
```

## src/examples/lqr_app_task/Kconfig
```kconfig
menuconfig EXAMPLES_LQR_APP_TASK
	bool "lqr_app_task"
	default n
	---help---
		Enable support for lqr_app_task
```

## src/modules/lqr_module/Kconfig
```kconfig
menuconfig MODULES_LQR_MODULE
    bool "lqr_module"
    default n
    ---help---
        Enable support for lqr_module
```
